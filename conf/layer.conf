## conf/layer.conf
```bitbake
# We have a conf and classes directory, add to BBPATH
BBPATH := "${BBPATH}:${LAYERDIR}"

# We have a recipes directory, add to BBFILES
BBFILES := "${BBFILES} ${LAYERDIR}/recipes-*/*/*.bb \
	${LAYERDIR}/recipes-*/*/*.bbappend"

BBFILE_COLLECTIONS += "taulabs-datalogger"
BBFILE_PATTERN_taulabs-datalogger := "^${LAYERDIR}/"
BBFILE_PRIORITY_taulabs-datalogger = "6"
```

## conf/machine/op-datalogger.conf
```bitbake
#@TYPE: Machine
#@NAME: op-datalogger

#@DESCRIPTION: Machine configuration for op-datalogger systems


# Ship all kernel modules by default
MACHINE_EXTRA_RRECOMMENDS = " kernel-modules"

# Allow for MMC booting (required by the NAND-less Beagleboard XM)
EXTRA_IMAGEDEPENDS += "u-boot"

# Add in packages that are useful for this platform
MACHINE_ESSENTIAL_EXTRA_RDEPENDS += " marvell-sdio-fw"
MACHINE_ESSENTIAL_EXTRA_RDEPENDS += " wireless-tools wpa-supplicant openssh iproute2 procps psmisc ethtool bzip2 xz sudo bluez4"

# Uncomment the following line to enable the hard floating point abi. Note that
# this breaks some binary libraries and 3D (neither of which ship with
# meta-yocto). For maximum compatibility, leave this disabled.
#DEFAULTTUNE ?= "cortexa8hf-neon"
include conf/machine/include/tune-cortexa8.inc

IMAGE_FSTYPES += "tar.bz2"

# 2.6.37 and later kernels use OMAP_SERIAL, ttyO2
# earlier kernels use ttyS2
SERIAL_CONSOLE = "115200 ttyO2"

PREFERRED_PROVIDER_virtual/kernel ?= "linux-yocto"
PREFERRED_VERSION_linux-yocto ?= "3.2%"

KERNEL_IMAGETYPE = "uImage"
KERNEL_COMPATIBLE_MACHINE = "overo"
LINUX_KERNEL_TYPE = "preempt_rt"

# Choose our own local version of u-boot for SPL/MLO and u-boot
PREFERRED_PROVIDER_virtual/bootloader = "u-boot"
UBOOT_MACHINE = "omap3_overo_config"
PREFERRED_VERSION_pn-u-boot = "2011.12"

# Disable all usage of VTs in sysvinit-inittab
USE_VT = "0"
SYSVINIT_ENABLED_GETTYS = ""

MACHINE_FEATURES = "kernel26 apm ext2 usbgadget usbhost vfat bluetooth"
```

## conf/machine/taulabs-datalogger.conf
```bitbake
#@TYPE: Machine
#@NAME: taulabs-datalogger

#@DESCRIPTION: Machine configuration for taulabs-datalogger systems

# To get access to the meta-ti DSP stuff
SOC_FAMILY = "omap3"
require conf/machine/include/soc-family.inc
MACHINE_KERNEL_PR ?= "r1"

# Ship all kernel modules by default
MACHINE_EXTRA_RRECOMMENDS = " kernel-modules"

# Allow for MMC booting (required by the NAND-less Beagleboard XM)
EXTRA_IMAGEDEPENDS += "u-boot"

# Add in packages that are useful for this platform
MACHINE_ESSENTIAL_EXTRA_RDEPENDS += " linux-firmware-sd8686"
MACHINE_ESSENTIAL_EXTRA_RDEPENDS += " taulabs-server"
MACHINE_ESSENTIAL_EXTRA_RDEPENDS += " taulabs-user"
MACHINE_ESSENTIAL_EXTRA_RDEPENDS += " taulabs-sudo"
MACHINE_ESSENTIAL_EXTRA_RDEPENDS += " taulabs-udev"
MACHINE_ESSENTIAL_EXTRA_RDEPENDS += " wifi-modules"
MACHINE_ESSENTIAL_EXTRA_RDEPENDS += " wireless-tools wpa-supplicant openssh iproute2 procps psmisc ethtool bzip2 xz sudo bluez4 bash"
MACHINE_ESSENTIAL_EXTRA_RDEPENDS += " yavta media-ctl"

# Uncomment the following line to enable the hard floating point abi. Note that
# this breaks some binary libraries and 3D (neither of which ship with
# meta-yocto). For maximum compatibility, leave this disabled.
#DEFAULTTUNE ?= "cortexa8hf-neon"
include conf/machine/include/tune-cortexa8.inc

IMAGE_FSTYPES += "tar.bz2"

# 2.6.37 and later kernels use OMAP_SERIAL, ttyO2
# earlier kernels use ttyS2
SERIAL_CONSOLE = "115200 ttyO2"

PREFERRED_PROVIDER_virtual/kernel ?= "linux-yocto"
PREFERRED_VERSION_linux-yocto ?= "3.4%"

KERNEL_IMAGETYPE = "uImage"
KERNEL_COMPATIBLE_MACHINE = "overo"
LINUX_KERNEL_TYPE = "preempt_rt"

# Choose our own local version of u-boot for SPL/MLO and u-boot
PREFERRED_PROVIDER_virtual/bootloader = "u-boot"
UBOOT_MACHINE = "omap3_overo_config"
PREFERRED_VERSION_pn-u-boot = "2011.12"

# Disable all usage of VTs in sysvinit-inittab
USE_VT = "0"
SYSVINIT_ENABLED_GETTYS = ""

MACHINE_FEATURES = "kernel26 apm ext2 usbgadget usbhost vfat bluetooth"

MACHINE_KERNEL_PR ?= "r1"
```
